/*
    * @file    oled_i2c.c
    * @brief   OLED I2C驱动程序
    * @version 1.0
    * @date    2023-10-01
    * @note    本文件实现了OLED显示屏的I2C通信和基本绘图功能。
    */
*/


/* Includes ----------------------------------------------------------------- */
#include "device/oled_i2c.h"
#include "bsp/i2c.h"
#include <string.h>
#include <stdint.h>
/* Private define ----------------------------------------------------------- */
#define OLED_I2C_ADDR 0x78 // OLED I2C 地址
#define OLED_WIDTH 128
#define OLED_HEIGHT 64

/* Private variables -------------------------------------------------------- */
static uint8_t oled_buffer[OLED_WIDTH * OLED_HEIGHT / 8];
static struct {
    uint8_t x_min;
    uint8_t x_max;
    uint8_t y_min;
    uint8_t y_max;
    uint8_t dirty; // 标志是否有脏区域
} dirty_rect = {0, 0, 0, 0, 0};

/* Private function prototypes ---------------------------------------------- */
static void OLED_WriteCommand(uint8_t cmd) {
    uint8_t data[2] = {0x00, cmd};
    HAL_I2C_Master_Transmit(BSP_I2C_GetHandle(BSP_I2C_OLED), OLED_I2C_ADDR, data, 2, HAL_MAX_DELAY);
}

static void OLED_WriteData(uint8_t *data, uint16_t size) {
    uint8_t buffer[size + 1];
    buffer[0] = 0x40;
    memcpy(&buffer[1], data, size);
    HAL_I2C_Master_Transmit(BSP_I2C_GetHandle(BSP_I2C_OLED), OLED_I2C_ADDR, buffer, size + 1, HAL_MAX_DELAY);
}

static void OLED_MarkDirty(uint8_t x, uint8_t y);
static void OLED_UpdateDirtyScreen(void);

static const uint8_t oled_font[95][8] = {
	{0x00,0x00,0x00,0x00,0x00,0x00,0x00,0x00,}, /* " ", 0 */
	{0x00,0x00,0x00,0xcf,0xcf,0x00,0x00,0x00,}, /* "!", 1 */
	{0x00,0x0c,0x06,0x00,0x0c,0x06,0x00,0x00,}, /* """, 2 */
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	{0x00,0x08,0x04,0x04,0x08,0x10,0x10,0x08,}, /* "~", 94 */
};


/* Exported functions ------------------------------------------------------- */

void OLED_Init(void) {
    OLED_WriteCommand(0xAE); // 关闭显示
    OLED_WriteCommand(0x20); // 设置内存寻址模式
    OLED_WriteCommand(0x10); // 页寻址模式
    OLED_WriteCommand(0xB0); // 设置页起始地址
    OLED_WriteCommand(0xC8); // 设置COM扫描方向
    OLED_WriteCommand(0x00); // 设置低列地址
    OLED_WriteCommand(0x10); // 设置高列地址
    OLED_WriteCommand(0x40); // 设置显示起始行
    OLED_WriteCommand(0x81); // 设置对比度
    OLED_WriteCommand(0xFF); // 最大对比度
    OLED_WriteCommand(0xA1); // 设置段重映射
    OLED_WriteCommand(0xA6); // 正常显示
    OLED_WriteCommand(0xA8); // 设置多路复用比率
    OLED_WriteCommand(0x3F); // 1/64
    OLED_WriteCommand(0xA4); // 输出跟随 RAM 内容
    OLED_WriteCommand(0xD3); // 设置显示偏移
    OLED_WriteCommand(0x00); // 无偏移
    OLED_WriteCommand(0xD5); // 设置显示时钟分频比/振荡频率
    OLED_WriteCommand(0xF0); // 高频
    OLED_WriteCommand(0xD9); // 设置预充电周期
    OLED_WriteCommand(0x22); // 修复缺少分号
    OLED_WriteCommand(0xDA); // 设置COM引脚硬件配置
    OLED_WriteCommand(0x12); // 修复缺少分号
    OLED_WriteCommand(0xDB); // 设置VCOMH电压
    OLED_WriteCommand(0x20); // 修复缺少分号
    OLED_WriteCommand(0x8D); // 设置充电泵
    OLED_WriteCommand(0x14); // 修复缺少分号
    OLED_WriteCommand(0xAF); // 打开显示
}

void OLED_Clear(void) {
    memset(oled_buffer, 0, sizeof(oled_buffer));
    dirty_rect.x_min = 0;
    dirty_rect.x_max = OLED_WIDTH - 1;
    dirty_rect.y_min = 0;
    dirty_rect.y_max = OLED_HEIGHT - 1;
    dirty_rect.dirty = 1;
    OLED_UpdateScreen();
}

void OLED_UpdateScreen(void) {
    OLED_UpdateDirtyScreen();
}

void OLED_DrawPixel(uint8_t x, uint8_t y, uint8_t color) {
    if (x >= OLED_WIDTH || y >= OLED_HEIGHT) return;

    if (color) {
        if (!(oled_buffer[x + (y / 8) * OLED_WIDTH] & (1 << (y % 8)))) {
            oled_buffer[x + (y / 8) * OLED_WIDTH] |= (1 << (y % 8));
            OLED_MarkDirty(x, y);
        }
    } else {
        if (oled_buffer[x + (y / 8) * OLED_WIDTH] & (1 << (y % 8))) {
            oled_buffer[x + (y / 8) * OLED_WIDTH] &= ~(1 << (y % 8));
            OLED_MarkDirty(x, y);
        }
    }
}

void OLED_DrawChar(uint8_t x, uint8_t y, char ch, uint8_t color) {
    if (ch < ' ' || ch > '~') return;

    if (x >= OLED_WIDTH || y >= OLED_HEIGHT || x + 8 > OLED_WIDTH || y + 8 > OLED_HEIGHT) {
        return;
    }

    const uint8_t *font_data = oled_font[ch - ' '];

    for (uint8_t i = 0; i < 8; i++) {
        uint8_t column_data = font_data[i];
        for (uint8_t j = 0; j < 8; j++) {
            if (column_data & (1 << j)) {
                OLED_DrawPixel(x + i, y + j, color);
            } else {
                OLED_DrawPixel(x + i, y + j, !color);
            }
        }
    }
}

void OLED_DrawString(uint8_t x, uint8_t y, const char *str, uint8_t color) {
    while (*str) {
        OLED_DrawChar(x, y, *str, color);
        x += 8;
        if (x + 8 > OLED_WIDTH) {
            x = 0;
            y += 8;
        }
        if (y + 8 > OLED_HEIGHT) {
            break;
        }
        str++;
    }
}

/* Private functions -------------------------------------------------------- */

static void OLED_MarkDirty(uint8_t x, uint8_t y) {
    if (!dirty_rect.dirty) {
        dirty_rect.x_min = x;
        dirty_rect.x_max = x;
        dirty_rect.y_min = y;
        dirty_rect.y_max = y;
        dirty_rect.dirty = 1;
    } else {
        if (x < dirty_rect.x_min) dirty_rect.x_min = x;
        if (x > dirty_rect.x_max) dirty_rect.x_max = x;
        if (y < dirty_rect.y_min) dirty_rect.y_min = y;
        if (y > dirty_rect.y_max) dirty_rect.y_max = y;
    }
}

static void OLED_UpdateDirtyScreen(void) {
    if (!dirty_rect.dirty) return;

    uint8_t y_start = dirty_rect.y_min / 8;
    uint8_t y_end = dirty_rect.y_max / 8;

    for (uint8_t i = y_start; i <= y_end; i++) {
        OLED_WriteCommand(0xB0 + i);
        OLED_WriteCommand(dirty_rect.x_min & 0x0F);
        OLED_WriteCommand(0x10 | (dirty_rect.x_min >> 4));
        uint8_t width = dirty_rect.x_max - dirty_rect.x_min + 1;
        OLED_WriteData(&oled_buffer[dirty_rect.x_min + i * OLED_WIDTH], width);
    }

    dirty_rect.dirty = 0;
}
